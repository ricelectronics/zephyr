/*
 * Copyright (c) 2023 Marius Scholtz <mariuss@ricelectronics.com>
 *
 * SPDX-License-Identifier: Apache-2.0
 */

#include <atmel/same70.dtsi>
#include <atmel/samx7xx20.dtsi>
#include "dma_atmel_same70.h"