## drivers/adc/Kconfig.sam_afec
```kconfig
# ADC configuration options

# Copyright (c) 2017 comsuisse AG
# Copyright (c) 2022 RIC Electronics
# SPDX-License-Identifier: Apache-2.0

config ADC_SAM_AFEC
	bool "SAM ADC Driver"
	depends on SOC_FAMILY_SAM
	help
	  Enable Atmel SAM MCU Family Analog-to-Digital Converter (ADC) driver
	  based on AFEC module.

if ADC_SAM_AFEC

config ADC_SAM_AFEC_DMA
	bool "Use DMA for the transfer"
	depends on DMA
	help
	  When enabled DMA will be used for the transfer. Note that
	  currently DMA requires a hardware trigger to be configured.
	  Please refer to the driver binding file and the datasheet
	  for more information on how to configure a hardware trigger.

config ADC_SAM_AFEC_TAG_CHANNEL
	bool "When using DMA include a channel tag"
	depends on ADC_SAM_AFEC_DMA
	help
	  When DMA is enabled optionally change the data width to 32-bits
	  and include a channel tag. This makes it easy to validate which
	  channel a sample came from.

	  Note that data caching is enabled by default so the cache must
	  be invalidated after reading to get the correct results.
	  For example:

	  adc_read_async(adc0, &seq, &signal);
	  SCB_InvalidateDCache_by_Addr(buffer, sizeof(buffer));

config ADC_SAM_AFEC_DMA_TIM_TIG
	bool "Use the timer for a hardware trigger"
	depends on DMA
	help
	  When enabled DMA will use the timer for the hardware trigger.
	  The trigger-source still needs to be set in the device tree
	  as there are different timers and channels.

config ADC_SAM_AFEC_SINGLE_TRIG_OS
	bool "Single Trigger required to sample"
	default y
	depends on ADC_SAM_AFEC
	help
	  When enabled only a single trigger is required to obtain a sample when oversampling

endif
```

## drivers/counter/Kconfig.sam
```kconfig
# Copyright (c) 2021 Piotr Mienkowski
# SPDX-License-Identifier: Apache-2.0

# Workaround for not being able to have commas in macro arguments
DT_COMPAT_ATMEL_SAM_TC := atmel,sam-tc

config COUNTER_SAM_TC
	bool "Atmel SAM MCU family counter (TC) driver"
	default $(dt_compat_enabled,$(DT_COMPAT_ATMEL_SAM_TC))
	depends on SOC_FAMILY_SAM
	help
	  Enable the Atmel SAM MCU family counter (TC) driver.

if COUNTER_SAM_TC

config COUNTER_SAM_TC_CAPTURE
	bool "Enable hardware specific support for capture mode"
	default n
	depends on SOC_FAMILY_SAM
	help
	  Enables support for input capture. This feature does
	  not use the counter api. To use it include the
	  following header:

	  #include <drivers/counter/sam_tc.h>

	  There is only a single function; sam_counter_read_capture
	  which can be used to read the input frequency on one
	  of the timer pins. As this is hardware specific please
	  refer to the datasheet for how to configure the timer
	  for input capture.

endif
```

## drivers/dma/Kconfig.sam_xdmac
```kconfig
# Atmel XDMAC SAM driver configuration options

# Copyright (c) 2017 Piotr Mienkowski
# Copyright (c) 2021 RIC Electronics
# SPDX-License-Identifier: Apache-2.0

config DMA_SAM_XDMAC
	bool "Atmel SAM DMA (XDMAC) driver"
	depends on SOC_FAMILY_SAM
	help
	  Enable Atmel SAM MCU Family Direct Memory Access (XDMAC) driver.

config DMA_SAM_XDMAC_DBL_BUFF
	bool "Continuous circular double buffer support for Atmel SAM DMA (XDMAC) driver"
	depends on SOC_FAMILY_SAM
	help
	  Enable double buffer support for Atmel SAM MCU Family Direct Memory Access (XDMAC) driver.
```

## drivers/serial/Kconfig.usart_sam
```kconfig
# Atmel SAM USART configuration options

# Copyright (c) 2016 Piotr Mienkowski
# SPDX-License-Identifier: Apache-2.0

# Workaround for not being able to have commas in macro arguments
DT_COMPAT_ATMEL_SAM_XDMAC := atmel,sam-xdmac

config USART_SAM
	bool "Atmel SAM MCU family USART driver"
	depends on SOC_FAMILY_SAM
	select SERIAL_HAS_DRIVER
	select SERIAL_SUPPORT_INTERRUPT
	# the ASYNC implementation requires a DMA controller
	select SERIAL_SUPPORT_ASYNC if $(dt_compat_enabled,$(DT_COMPAT_ATMEL_SAM_XDMAC))
	select DMA if UART_ASYNC_API
	help
	  This option enables the USARTx driver for Atmel SAM MCUs.
```

## dts/bindings/adc/atmel,sam-afec.yaml
```yaml
description: Atmel SAM family AFEC

compatible: "atmel,sam-afec"

include: adc-controller.yaml

properties:
    reg:
      required: true

    interrupts:
      required: true

    peripheral-id:
      type: int
      description: peripheral ID
      required: true

    "#io-channel-cells":
      const: 1

    pinctrl-0:
      type: phandles
      required: true
      description: |
        PIO pin configuration for ADTRG signal.  We expect that
        the phandles will reference pinctrl nodes.  These nodes will
        have a nodelabel that matches the Atmel SoC HAL defines and
        be of the form p<port><pin><periph>_<inst>_<signal>.

        For example the I2C on SAME7x would be
           pinctrl-0 = <&pa8b_afec0_adtrg>;

    dma-channel:
      type: int
      required: false
      description: |
        Select the DMA channel to use. The hardware supports a total
        of 24 different channels. Make sure there are no conflicts
        with other drivers.

        Currently when DMA is enabled a hardware trigger source must be
        setup. See trigger-source below.

    trigger-source:
      type: int
      required: false
      default: 0
      enum:
        - 0 # Software driven
        - 1 # TIOA output of Timer Counter channel 0 for AFEC0
            # TIOA output of Timer Counter channel 3 for AFEC1
        - 2 # TIOA output of Timer Counter channel 1 for AFEC0
            # TIOA output of Timer Counter channel 4 for AFEC1
        - 3 # TIOA output of Timer Counter channel 2 for AFEC0
            # TIOA output of Timer Counter channel 5 for AFEC1
        - 4 # PWM0 event line 0 for AFEC0
            # PWM1 event line 0 for AFEC1
        - 5 # PWM0 event line 1 for AFEC0
            # PWM1 event line 1 for AFEC1
        - 6 # Analog Comparator
      description: |
        The trigger source of the ADC conversions. If a hardware
        source is selected, the hardware pheripheral will need
        to be setup separately to generate the event. This driver
        only configures the AFEC side. Please refer to the
        datasheet for more information. Also note that only the
        timer has been tested as a trigger source.

    tc:
      type: int
      required: false
      description: |
        When trigger-source 1, 2 or 3 is configured then this
        value indicate the timer counter that will be started
        and stopped by the driver to generate the trigger
        events required for conversions. e.g
        tc = <0> indicate tc0 will be used.

io-channel-cells:
    - input
```

## dts/bindings/adc/st,stm32-adc.yaml
```yaml
# Copyright (c) 2018, Endre Karlson
# Copyright (c) 2018, Song Qiang <songqiang1304521@gmail.com>
# Copyright (c) 2021 Marius Scholtz, RIC Electronics
#
# SPDX-License-Identifier: Apache-2.0

description: ST STM32 family ADC

compatible: "st,stm32-adc"

include: adc-controller.yaml

properties:
    reg:
      required: true

    clocks:
      required: true

    prescalar:
      type: int
      required: false
      description: |
        The prescalar to apply to the ADC clock

    pinctrl-0:
      type: phandles
      required: false
      description: |
        GPIO pin configuration for ADC input. The phandles are
        expected to reference pinctrl nodes, e.g.
           pinctrl-0 = <&adc_in0_pa0 &adc_in1_pa1>;

    interrupts:
      required: true

    "#io-channel-cells":
      const: 1

io-channel-cells:
    - input
```
